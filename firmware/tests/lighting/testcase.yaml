## firmware/tests/lighting/testcase.yaml
```yaml
common:
  tags:
    - lighting
    - led_strip
  integration_platforms:
    - native_sim/native/64
  platform_allow:
    - native_sim/native/64
    - qemu_cortex_m3
    - nrf54l15dk/nrf54l15/cpuapp
    - nucleo_wb55rg/stm32wb55xx
  harness: ztest
tests:
  meshlight.lighting.six: {}
  meshlight.lighting.one:
    extra_args:
      - EXTRA_DTC_OVERLAY_FILE=one.overlay
  meshlight.lighting.seventeen:
    extra_args:
      - EXTRA_DTC_OVERLAY_FILE=seventeen.overlay
```

## firmware/tests/lighting_persistence/testcase.yaml
```yaml
common:
  tags: [lighting, settings, shell]
  platform_allow: [qemu_cortex_m3]
  integration_platforms: [qemu_cortex_m3]
  harness: ztest
tests:
  meshlight.persistence.empty: {}
  meshlight.persistence.restored:
    extra_args: [BOOT_MODE=1]
  meshlight.persistence.legacy_off:
    extra_args: [BOOT_MODE=2]
  meshlight.persistence.corrupt:
    extra_args: [BOOT_MODE=3]
  meshlight.persistence.future:
    extra_args: [BOOT_MODE=4]
  meshlight.persistence.unavailable:
    extra_args: [BOOT_MODE=5]
  meshlight.persistence.legacy_on:
    extra_args: [BOOT_MODE=6]
  meshlight.persistence.zero_intensity:
    extra_args: [BOOT_MODE=7]
  meshlight.persistence.read_error:
    extra_args: [BOOT_MODE=8]
  meshlight.persistence.oversized:
    extra_args: [BOOT_MODE=9]
```

## firmware/tests/lighting_quiesce/testcase.yaml
```yaml
common:
  tags: [lighting, reset]
  platform_allow: [qemu_cortex_m3]
  integration_platforms: [qemu_cortex_m3]
  harness: ztest
tests:
  meshlight.lighting.quiesce: {}
```

## firmware/tests/lighting_refresh/testcase.yaml
```yaml
common:
  tags:
    - lighting
    - led_strip
  integration_platforms:
    - native_sim/native/64
  platform_allow:
    - native_sim/native/64
    - qemu_cortex_m3
  harness: ztest
  timeout: 60
tests:
  meshlight.lighting_refresh.default: {}
  meshlight.lighting_refresh.custom_interval:
    extra_configs:
      - CONFIG_LIGHTING_REFRESH_INTERVAL_MS=20
```

## firmware/tests/mesh/testcase.yaml
```yaml
common:
  tags: [mesh, lighting]
  platform_allow: [qemu_cortex_m3]
  integration_platforms: [qemu_cortex_m3]
  harness: ztest
tests:
  meshlight.mesh.six: {}
  meshlight.mesh.one:
    extra_args: [EXTRA_DTC_OVERLAY_FILE=one.overlay]
  meshlight.mesh.seventeen:
    extra_args: [EXTRA_DTC_OVERLAY_FILE=seventeen.overlay]
  meshlight.mesh.long:
    extra_args: [EXTRA_DTC_OVERLAY_FILE=long.overlay]
  meshlight.mesh.maximum:
    extra_args: [EXTRA_DTC_OVERLAY_FILE=maximum.overlay]
```

## firmware/tests/mesh_crypto/testcase.yaml
```yaml
common:
  tags: [mesh, crypto, settings]
  platform_allow: [qemu_cortex_m3]
  integration_platforms: [qemu_cortex_m3]
  harness: ztest
tests:
  meshlight.mesh_crypto.zms: {}
  meshlight.mesh_crypto.small_heap:
    extra_configs:
      - CONFIG_MBEDTLS_HEAP_SIZE=4096
```

## firmware/tests/storage/testcase.yaml
```yaml
common:
  tags: [storage, settings]
  platform_allow: [qemu_cortex_m3]
  integration_platforms: [qemu_cortex_m3]
  harness: ztest
tests:
  meshlight.storage.nvs:
    extra_configs:
      - CONFIG_NVS=y
      - CONFIG_SETTINGS_NVS=y
      - CONFIG_NVS_DATA_CRC=y
      - CONFIG_SETTINGS_NVS_SECTOR_COUNT=2
  meshlight.storage.zms:
    extra_configs:
      - CONFIG_ZMS=y
      - CONFIG_SETTINGS_ZMS=y
      - CONFIG_ZMS_DATA_CRC=y
      - CONFIG_ZMS_NO_DOUBLE_WRITE=y
      - CONFIG_SETTINGS_ZMS_CUSTOM_SECTOR_COUNT=y
      - CONFIG_SETTINGS_ZMS_SECTOR_COUNT=4
      - CONFIG_FLASH_SIMULATOR_EXPLICIT_ERASE=n
```
